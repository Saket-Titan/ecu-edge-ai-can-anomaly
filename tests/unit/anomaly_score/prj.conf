## CMakeLists.txt
```
cmake_minimum_required(VERSION 3.20.0)
find_package(Zephyr REQUIRED HINTS $ENV{ZEPHYR_BASE})

project(anomaly_test)

target_include_directories(app PRIVATE
	../../../firmware/ids_node/src
)

target_sources(app PRIVATE
	../../../firmware/ids_node/src/manual_inference.c
	src/main.c
)
```

## prj.conf
```kconfig
CONFIG_ZTEST=y
CONFIG_FPU=y
CONFIG_NEWLIB_LIBC=y
```

## src/main.c
```c
#include <zephyr/ztest.h>
#include "model_weights.h"
#include "manual_inference.h"
ZTEST(anomaly_suite, test_normal_data)
{
  uint8_t normal_input[] = {0x00, 0x00, 0x00, 0x2E, 0xE0, 0x00, 0x00, 0x00};
  float score = anomaly_score(normal_input);
  
  printk("Normal Data Score: %d/1000 \n", (int)(score*1000));
  zassert_true(score < ANOMALY_THRESHOLD, "Score exceeded threshold");
}

ZTEST(anomaly_suite, test_attack_data)
{
  uint8_t attack_input[] = {0x00, 0x12, 0x55, 0xAA, 0xBB, 0xCC, 0xDD, 0xEE};
  float score = anomaly_score(attack_input);
  printk("Attack Data Score: %d/1000", (int)(score*1000));
  
  zassert_true(score >= 0.0f, "Score must be positive");
}
ZTEST_SUITE(anomaly_suite, NULL, NULL, NULL, NULL, NULL);
```
