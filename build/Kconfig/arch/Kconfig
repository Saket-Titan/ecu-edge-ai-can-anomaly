## build/Kconfig/arch/Kconfig
```kconfig
# Load Zephyr Arch Kconfig descriptions.
osource "/home/saket-jha/zephyrproject/zephyr/arch/rx/Kconfig"
osource "/home/saket-jha/zephyrproject/zephyr/arch/x86/Kconfig"
osource "/home/saket-jha/zephyrproject/zephyr/arch/xtensa/Kconfig"
osource "/home/saket-jha/zephyrproject/zephyr/arch/sparc/Kconfig"
osource "/home/saket-jha/zephyrproject/zephyr/arch/riscv/Kconfig"
osource "/home/saket-jha/zephyrproject/zephyr/arch/posix/Kconfig"
osource "/home/saket-jha/zephyrproject/zephyr/arch/mips/Kconfig"
osource "/home/saket-jha/zephyrproject/zephyr/arch/arm64/Kconfig"
osource "/home/saket-jha/zephyrproject/zephyr/arch/arm/Kconfig"
osource "/home/saket-jha/zephyrproject/zephyr/arch/arc/Kconfig"
```

## build/Kconfig/boards/Kconfig
```kconfig
# Load Zephyr board Kconfig descriptions.
osource "/home/saket-jha/zephyrproject/zephyr/boards/st/nucleo_g474re/Kconfig"
```

## build/Kconfig/boards/Kconfig.defconfig
```kconfig
# Load Zephyr board defconfig descriptions.
osource "/home/saket-jha/zephyrproject/zephyr/boards/st/nucleo_g474re/Kconfig.defconfig"
```

## build/Kconfig/boards/Kconfig.nucleo_g474re
```kconfig
# Load board Kconfig descriptions.
osource "/home/saket-jha/zephyrproject/zephyr/boards/st/nucleo_g474re/Kconfig.nucleo_g474re"
```

## build/Kconfig/boards/Kconfig.sysbuild
```kconfig
# Load Sysbuild board Kconfig descriptions.
osource "/home/saket-jha/zephyrproject/zephyr/boards/st/nucleo_g474re/Kconfig.sysbuild"
```

## build/ids_node/Kconfig/boards/Kconfig.nucleo_h723zg
```kconfig
# Load board Kconfig descriptions.
osource "/home/saket-jha/zephyrproject/zephyr/boards/st/nucleo_h723zg/Kconfig.nucleo_h723zg"
```

## tests/unit/build/Kconfig/boards/Kconfig.defconfig
```kconfig
# Load Zephyr board defconfig descriptions.
osource "/home/saket-jha/zephyrproject/zephyr/boards/st/nucleo_h723zg/Kconfig.defconfig"
```

## tests/unit/build/Kconfig/boards/Kconfig.sysbuild
```kconfig
# Load Sysbuild board Kconfig descriptions.
osource "/home/saket-jha/zephyrproject/zephyr/boards/st/nucleo_h723zg/Kconfig.sysbuild"
```
